/**************************************************************************
This is the current GUI code for the Fetch Tracking system

Written by Christopher Texler
 **************************************************************************/

#include <SPI.h>
#include <Wire.h>
#include <LoRa.h>
#include <Adafruit_GFX.h>
#include <Adafruit_SSD1306.h>

#define SCREEN_WIDTH 128 // OLED display width, in pixels
#define SCREEN_HEIGHT 32 // OLED display height, in pixels

// Declaration for an SSD1306 display connected to I2C (SDA, SCL pins)
#define OLED_RESET     4 // Reset pin # (or -1 if sharing Arduino reset pin)
Adafruit_SSD1306 display(SCREEN_WIDTH, SCREEN_HEIGHT, &Wire, OLED_RESET);

int RSSi = RSSi; //RSSI value
int counter = 0;


#define LOGO_HEIGHT   32
#define LOGO_WIDTH    64
static const unsigned char PROGMEM logo_bmp[] =
{ 0x00, 0x00, 0x00, 0x00, 0x00, 0x00, 0x00, 0x00, 0x00, 0x0f, 0xc0, 0x00, 0x00, 0x0f, 0xc0, 0x00, 
  0x00, 0x7f, 0x00, 0x00, 0x00, 0x1f, 0xf8, 0x00, 0x00, 0x7c, 0x00, 0x00, 0x00, 0x7c, 0xf9, 0x00, 
  0x0e, 0xfc, 0x3f, 0xff, 0xff, 0xfc, 0xfd, 0xc0, 0x1f, 0x7f, 0xff, 0xff, 0xff, 0xfe, 0xfb, 0xe0, 
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  0x00, 0x00, 0x00, 0x01, 0x00, 0x00, 0x00, 0x00, 0x00, 0x00, 0x00, 0x01, 0x00, 0x00, 0x00, 0x00,};

void setup() {
 // SSD1306_SWITCHCAPVCC = generate display voltage from 3.3V internally
  if(!display.begin(SSD1306_SWITCHCAPVCC, 0x3C)) { // Address 0x3C for 128x32
    Serial.println(F("SSD1306 allocation failed"));
    for(;;); // Don't proceed, loop forever
  }

  Serial.begin(9600);
  
  if (!LoRa.begin(915E6)) 
  {
    Serial.println("Starting LoRa failed!");
    while (1);
  }

 
 
  // Clear the buffer
  display.clearDisplay();


  drawlogo();    // Draw a splashscreen of the Old Phoenix Sub-Orbital Logo

}

void loop() {
    /*
	
	- There is no RSSi to measure, not receivving any packets from the GS
	- regardless there's no function call toLoRa.packetRssi();
	
	drawRSSI();    // Draw the current RSSI value based on a varbile set earlier in the code
    */
	
	
	
	delay(500);
    display.clearDisplay();
    delay(500);
    Serial.print("Sending packet: ");
    Serial.println(counter);

    // send packet
    LoRa.beginPacket();
    LoRa.print("hello ");
    LoRa.print(counter);
    LoRa.endPacket();

    counter++;

}

void drawRSSI(void) {
  display.clearDisplay();
  
  display.setTextSize(3);             // Draw 3X-scale text
  display.setTextColor(SSD1306_WHITE);
  display.setCursor(0,0);             // Start at top-left corner
  display.print("RSSI:");
  display.println(RSSi);

  display.display();
  delay(100);
}



void drawlogo(void) {
  display.clearDisplay();

  display.drawBitmap(
    (display.width()  - LOGO_WIDTH ) / 2,
    (display.height() - LOGO_HEIGHT) / 2,
    logo_bmp, LOGO_WIDTH, LOGO_HEIGHT, 1);
  display.display();
  delay(3000);
}
